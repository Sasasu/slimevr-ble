## firmware/boards/arm/nrf52810/Kconfig
```kconfig
# nRF52810 board configuration

# SPDX-License-Identifier: Apache-2.0

config BOARD_ENABLE_DCDC
	bool "DCDC mode"
	select SOC_DCDC_NRF52X
	default y

config BT_CTLR
	default y if BT
```

## firmware/boards/arm/nrf52810/Kconfig.board
```kconfig
# nRF52810 board configuration

# SPDX-License-Identifier: Apache-2.0

config BOARD_NRF52810
	bool "nRF52810"
	depends on SOC_NRF52810_QFAA
```

## firmware/boards/arm/nrf52810/Kconfig.defconfig
```kconfig
# nRF52810 board configuration

# SPDX-License-Identifier: Apache-2.0

if BOARD_NRF52810

config BOARD
	default "nrf52810"

config BT_CTLR
	default BT

endif # BOARD_NRF52810
```

## firmware/boards/arm/nrf52810/nrf52810_defconfig
```kconfig
# SPDX-License-Identifier: Apache-2.0

CONFIG_SOC_SERIES_NRF52X=y
CONFIG_SOC_NRF52810_QFAA=y
CONFIG_BOARD_NRF52810=y

# Enable MPU
CONFIG_ARM_MPU=y

# Enable hardware stack protection
CONFIG_HW_STACK_PROTECTION=y

# enable GPIO
CONFIG_GPIO=y
CONFIG_PINCTRL=y

# enable uart driver
CONFIG_SERIAL=y

# enable console
CONFIG_CONSOLE=y
CONFIG_UART_CONSOLE=y

CONFIG_IDLE_STACK_SIZE=96
CONFIG_ISR_STACK_SIZE=348
CONFIG_MAIN_STACK_SIZE=1024
CONFIG_PRIVILEGED_STACK_SIZE=128
CONFIG_SYSTEM_WORKQUEUE_STACK_SIZE=1024
CONFIG_BT_RX_STACK_SIZE=1024

CONFIG_LOG=y
CONFIG_LOG_MODE_MINIMAL=y
CONFIG_LOG_MODE_IMMEDIATE=y
#CONFIG_DEBUG_OPTIMIZATIONS=y
#CONFIG_DEBUG_THREAD_INFO=y

CONFIG_THREAD_NAME=y
#CONFIG_THREAD_ANALYZER=y
#CONFIG_THREAD_ANALYZER_AUTO=y
#CONFIG_THREAD_ANALYZER_RUN_UNLOCKED=y
#CONFIG_THREAD_ANALYZER_USE_PRINTK=y
#CONFIG_THREAD_ANALYZER_AUTO_INTERVAL=60
#CONFIG_THREAD_ANALYZER_AUTO_STACK_SIZE=1024
#CONFIG_SYSTEM_WORKQUEUE_STACK_SIZE=1024
```

## firmware/drivers/icm/icm20948/Kconfig
```kconfig
config ICM20948
	bool "ICM20948"
	default n
	depends on DT_HAS_SLIMEVR_ICM20948_ENABLED
	help
	  Enable ICM20948
```

## firmware/drivers/slimevr/battery/Kconfig
```kconfig
config BATTERY
	bool "Battery"
	default y

config ADC_FUEL_GAUGE
	bool "ADC_FUEL_GAUGE"
	default n
	depends on DT_HAS_SLIMEVR_ADC_FUEL_GAUGE_ENABLED
	help
	  Enable ADC based fuel gauge
```

## firmware/drivers/slimevr/blesink/Kconfig
```kconfig
config BLESINK
	bool "BLESINK"
	default n
	depends on DT_HAS_SLIMEVR_BLESINK_ENABLED
	help
	  Enable Bluetooth output
```

## firmware/dts/bindings/slimevr,adc-fuel-gauge.yaml
```yaml
# Copyright (c) 2019, Peter Bigot Consulting, LLC
# SPDX-License-Identifier: Apache-2.0

description: |
  ADC based fuel gauge

compatible: "slimevr,adc-fuel-gauge"

include: base.yaml

properties:
  io-channels:
    type: phandle-array
    required: true
    description: |
      Channel available with this divider configuration.

  output-ohms:
    type: int
    required: true
    description: |
      Resistance of the lower leg of the voltage divider

  full-ohms:
    type: int
    required: true
    description: |
      Resistance of the full path through the voltage divider.

  battery-full-mv:
    type: int
    required: true
    description: Max charge voltage

  battery-empty-mv:
    type: int
    required: true
    description: Typical end-of-discharge
```

## firmware/dts/bindings/slimevr,blesink.yaml
```yaml
description: Bluetooth output with Slimevr protocol

compatible: "slimevr,blesink"

include: base.yaml

properties:
  battery:
    type: phandle
    required: true
    description: Battery fuel gauge
```

## firmware/dts/bindings/slimevr,icm20948-spi.yaml
```yaml
description: ICM20948 motion tracking device

compatible: "slimevr,icm20948"

include: [spi-device.yaml]

properties:
  int-gpios:
    type: phandle-array
    description: |
       The INT signal default configuration is active-high. The
       property value should ensure the flags properly describe the
       signal that is presented to the driver.
```

## firmware/west.yml
```yaml
manifest:
  remotes:
    - name: sasasu
      url-base: https://github.com/Sasasu
    - name: ncs
      url-base: https://github.com/nrfconnect

  self:
    path: firmware
    west-commands: scripts/west-commands.yml

  projects:
    - name: nrf
      remote: ncs
      repo-path: sdk-nrf
      revision: main
      import: true
```
