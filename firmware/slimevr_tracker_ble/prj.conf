## CMakeLists.txt
```
# SPDX-License-Identifier: Apache-2.0

cmake_minimum_required(VERSION 3.20.0)
find_package(Zephyr REQUIRED HINTS $ENV{ZEPHYR_BASE})
project(slimevr_tracker_ble)

target_sources(app PRIVATE
  src/main.c
)
```

## prj.conf
```kconfig
CONFIG_BT=y
CONFIG_BT_SMP=y
CONFIG_BT_PERIPHERAL=y
CONFIG_BT_DEVICE_NAME="SlimeVR Tracker - nRF52810"
CONFIG_BT_BAS=y

CONFIG_SPI=y

CONFIG_ICM20948=y
CONFIG_BLESINK=y

CONFIG_ADC=y
CONFIG_BATTERY=y
CONFIG_ADC_FUEL_GAUGE=y
```

## src/main.c
```c
#include "zephyr/kernel.h"
#include <stdbool.h>
#include <zephyr/logging/log.h>

LOG_MODULE_REGISTER(main);

int main(void) {
  LOG_INF("Starting SlimeVR Tracker");

  while (true) {
    k_sleep(K_SECONDS(1000));
  }

  return 0;
}
```
